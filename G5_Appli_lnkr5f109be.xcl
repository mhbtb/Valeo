//=================================================================================================
// Project      = Data Flash Library, MF3 single voltage flash
// Module       = fdl_sample_linker_file.xcl
// Device:      = RL78
// Version      = V1.04
// Date         = 13.04.2012 
//=================================================================================================
//                                  COPYRIGHT
//=================================================================================================
// Copyright (c) 2011-2012 by Renesas Electronics Europe GmbH, a company of the Renesas Electronics
// Corporation. All rights reserved.
//=================================================================================================
// Purpose:
//              linker sample file
//
//=================================================================================================
//
// Warranty Disclaimer
//
// Because the Product(s) is licensed free of charge, there is no warranty of any kind whatsoever
// and expressly disclaimed and excluded by Renesas, either expressed or implied, including but
// not limited to those for non-infringement of intellectual property, merchantability and/or
// fitness for the particular purpose.
// Renesas shall not have any obligation to maintain, service or provide bug fixes for the
// supplied Product(s) and/or the Application.
//
// Each User is solely responsible for determining the appropriateness of using the Product(s)
// and assumes all risks associated with its exercise of rights under this Agreement, including,
// but not limited to the risks and costs of program errors, compliance with applicable laws,
// damage to or loss of data, programs or equipment, and unavailability or interruption of
// operations.
//
// Limitation of Liability
//
// In no event shall Renesas be liable to the User for any incidental, consequential, indirect,
// or punitive damage (including but not limited to lost profits) regardless of whether such
// liability is based on breach of contract, tort, strict liability, breach of warranties,
// failure of essential purpose or otherwise and even if advised of the possibility of such
// damages. Renesas shall not be liable for any services or products provided by third party
// vendors, developers or consultants identified or referred to the User by Renesas in
// connection with the Product(s) and/or the Application.
//
//=================================================================================================
//
// Environment  = IAR environment for RL78 (version V1.xx)
//
//=================================================================================================




//-------------------------------------------------------------------------
//      Define CPU
//-------------------------------------------------------------------------
-cRL78

//-------------------------------------------------------------------------
//      Size of the stack.
//      Remove comment and modify number if used from command line.
//-------------------------------------------------------------------------
//-D_CSTACK_SIZE=80

//-------------------------------------------------------------------------
//      Near constant location.
//      0 -> Mirrored in rom area 0x00000 - 0x0FFFF
//      1 -> Mirrored in rom area 0x10000 - 0x1FFFF
//      2 -> Writeable constants
//      Remove comments and modify number if used from command line.
//-------------------------------------------------------------------------
//-D_NEAR_CONST_LOCATION=0
//-D_NEAR_CONST_LOCATION_START=00800
//-D_NEAR_CONST_LOCATION_END=00FFF

//-------------------------------------------------------------------------
//      Size of the heaps.
//      Remove comment and modify number if used from command line.
//-------------------------------------------------------------------------
//-D_NEAR_HEAP_SIZE=400
//-D_FAR_HEAP_SIZE=4000

//-------------------------------------------------------------------------
//      Used by DLIB only
//      Define the format functions used by printf/scanf.
//      Default is full formatting.
//      Remove appropriate comment(s) to get reduced formatting
//      if used from command line.
//-------------------------------------------------------------------------
//-e_PrintfTiny=_Printf
//-e_PrintfSmall=_Printf
//-e_PrintfLarge=_Printf

//-e_ScanfSmall=_Scanf
//-e_ScanfLarge=_Scanf

//-------------------------------------------------------------------------
//      Used by DLIB only
//      Define if row buffering should be used by terminal output.
//      Default is no buffering.
//      Remove comment to get buffered terminal output if used from command line.
//-------------------------------------------------------------------------
//-e__write_buffered=__write

//-------------------------------------------------------------------------
//      Used by CLIB only
//      Define the format functions used by printf/scanf.
//      Default is full formatting.
//      Remove appropriate comment(s) to get reduced formatting
//      if used from command line.
//-------------------------------------------------------------------------
//-e_small_write=_formatted_write
//-e_medium_write=_formatted_write

//-e_medium_read=_formatted_read

//-------------------------------------------------------------------------
//      Allocate the read only segments that are mapped to ROM.
//-------------------------------------------------------------------------
//-------------------------------------------------------------------------
//      Interrupt vector segment.
//-------------------------------------------------------------------------
-Z(CODE)INTVEC=0000-007F

//-------------------------------------------------------------------------
//      CALLT vector segment.
//-------------------------------------------------------------------------
-Z(CODE)CLTVEC=0080-00BD

//-------------------------------------------------------------------------
//      OPTION BYTES segment.
//-------------------------------------------------------------------------
-Z(CODE)OPTBYTE=00C0-00C3

//-------------------------------------------------------------------------
//      SECURITY_ID segment.
//-------------------------------------------------------------------------
-Z(CODE)SECUID=00C4-00CD



//-------------------------------------------------------------------------
//     Reserved ROM areas for OCD Firmware: 000CE-000D7
//                                          0FC00-0FFFF
//-------------------------------------------------------------------------

//-------------------------------------------------------------------------
//      Near Constant segments
//-------------------------------------------------------------------------

-Z(CONST)NEAR_CONST=_NEAR_CONST_LOCATION_START-_NEAR_CONST_LOCATION_END




//-------------------------------------------------------------------------
//      Startup, Runtime-library, Near, Interrupt
//      and CALLT functions code segment and near switch.
//-------------------------------------------------------------------------
-Z(CODE)RCODE,CODE=[2000-FEEF]
-Z(CONST)SWITCH=[2000-FEEF]

// PFDL
// ============
-Z(CODE)PFDL_COD=[2000-FEEF]

//-------------------------------------------------------------------------
//     Near Data initializer segments.
//-------------------------------------------------------------------------

-Z(CONST)NEAR_ID=[02000-FEEF]
-Z(CONST)SADDR_ID=[02000-FEEF]
-Z(CONST)DIFUNCT=[02000-FEEF]

//-------------------------------------------------------------------------
//      FAR far data segments.
//      The FAR_I and FAR_ID segments must start at the same offset
//      in a 64 Kb page.
//-------------------------------------------------------------------------

-Z(FARCONST)FAR_ID=2000-FEEF
-P(CONST)FAR_CONST,END_BOOTSEG_TWO,BOOTSEG_TWO,FSWITCH=[2000-FEEF]

-Z(FARDATA)FAR_I=FF800-FFEDF


//-------------------------------------------------------------------------
//      Far functions code segment.
//-------------------------------------------------------------------------
-Z(CODE)XCODE=[02000-FEEF]




//-------------------------------------------------------------------------
//      Allocate the read/write segments that are mapped to RAM.
//-------------------------------------------------------------------------
//-------------------------------------------------------------------------
//      Short address data and workseg segments.
//-------------------------------------------------------------------------
-Z(DATA)WRKSEG=FFE20-FFEDF
-Z(DATA)FDL_DATA,SADDR_I,SADDR_Z,SADDR_N=FFE20-FFEDF
//-------------------------------------------------------------------------
//      Near data segments.
//-------------------------------------------------------------------------

-Z(DATA)NEAR_I,NEAR_Z,HUGE_Z=FF310-FFD1F
-Z(DATA)RAM_GUARD=FF000-FF0FF
-Z(DATA)NEAR_N=FFD20-FFD9F

//-------------------------------------------------------------------------
//      Stack segment.
//-------------------------------------------------------------------------
-Z(DATA)CSTACK+_CSTACK_SIZE=FF310-FFD1F


//-------------------------------------------------------------------------
//      Heap segments.
//-------------------------------------------------------------------------
-Z(DATA)NEAR_HEAP+_NEAR_HEAP_SIZE=FF310-FFD1F
-Z(DATA)FAR_HEAP+_FAR_HEAP_SIZE=[FF310-FFD1F]/10000

//-------------------------------------------------------------------------
//      Far data segments.
//-------------------------------------------------------------------------
-Z(FARDATA)FAR_Z=FFDA0-FFE1F


-J2,crc16,,chksum2000_FEEF,CHECKSUM=(CODE)2000-FEEF
-J2,crc16,m,chksum_mirror2000_FEEF,CHECKSUM=(CODE)2000-FEEF

-Z(CODE)CHECKSUM=FEF0-FEFF

//-------------------------------------------------------------------------
//      Select the output file format if used from command line.
//      Remove comment to select the file format if used from command line.
//-------------------------------------------------------------------------
//-Fdebug


//-------------------------------------------------------------------------
//      End of File
//-------------------------------------------------------------------------